## config/boards/shields/clavier/Kconfig.defconfig
```kconfig
if SHIELD_CLAVIER_LEFT || SHIELD_CLAVIER_RIGHT

config ZMK_KEYBOARD_NAME
    default "clavier16"

config ZMK_SPLIT
    default y

if SHIELD_CLAVIER_LEFT

config ZMK_SPLIT_ROLE_CENTRAL
    default y

endif # SHIELD_CLAVIER_LEFT

endif # SHIELD_CLAVIER_LEFT || SHIELD_CLAVIER_RIGHT
```
